/******************************************************************************
*
* Copyright (C) 2026 ZHFG, Inc.  All rights reserved.
*
* Description:
* This file contains the implementation of the axi_radio_hw interrupt driver.
* The single interrupt source spi_mailbox_irq is routed to Zynq PS IRQ_F2P[0],
* which maps to GIC SPI interrupt ID 61.
*
******************************************************************************/

#include "no_os_error.h"
#include "no_os_alloc.h"
#include "xparameters.h"
#include "xilinx_irq.h"
#include "axi_radio_hw_irq.h"

/******************************************************************************/
/* Interrupt service routine                                                  */
/******************************************************************************/

/**
 * @brief SPI mailbox interrupt service routine.
 * @param context - axi_radio_hw_irq instance.
 *
 * The interrupt is a one-cycle pulse generated by the PL when the SPI host
 * writes arm_cmd_0 with bit[31] set. The hardware auto-clears bit[31], so the
 * payload is available in arm_cmd_0[30:0]. There is nothing to clear on the PL
 * side; the line already returned to 0 by the time the GIC services it.
 */
static void axi_radio_hw_irq_handler(void *context)
{
	struct axi_radio_hw_irq *dev = context;

	dev->irq_count++;

	/* Latch the command payload (bit[31] already cleared by hardware). */
	axi_radio_hw_read_reg(dev->radio_hw, AXI_RADIO_HW_REG_ARM_CMD_0,
			      (uint32_t *)&dev->arm_cmd_0);

	if (dev->mailbox_cb)
		dev->mailbox_cb(dev->mailbox_ctx);
}

/******************************************************************************/
/* Init / Remove                                                              */
/******************************************************************************/

/**
 * @brief Initialize the axi_radio_hw interrupt instance and enable it.
 * @param device - Pointer where the allocated instance is returned.
 * @param init   - Initialization parameters.
 * @return 0 on success, negative error code otherwise.
 */
int32_t axi_radio_hw_irq_init(struct axi_radio_hw_irq **device,
			      const struct axi_radio_hw_irq_init_param *init)
{
	struct axi_radio_hw_irq *dev;
	struct xil_irq_init_param xil_irq_init_par = {
		.type = IRQ_PS,
	};
	struct no_os_irq_init_param irq_init_param = {
		.irq_ctrl_id = XPAR_SCUGIC_0_DEVICE_ID,
		.platform_ops = &xil_irq_ops,
		.extra = &xil_irq_init_par,
	};
	int32_t ret;

	if (!device || !init)
		return -EINVAL;

	dev = (struct axi_radio_hw_irq *)no_os_calloc(1, sizeof(*dev));
	if (!dev)
		return -ENOMEM;

	dev->radio_hw = init->radio_hw;
	dev->irq_id = init->irq_id ? init->irq_id : AXI_RADIO_HW_IRQ_ID;
	dev->mailbox_cb = init->mailbox_cb;
	dev->mailbox_ctx = init->mailbox_ctx;

	ret = no_os_irq_ctrl_init(&dev->irq_ctrl, &irq_init_param);
	if (ret)
		goto error;

	dev->callback_desc.callback = axi_radio_hw_irq_handler;
	dev->callback_desc.ctx = dev;

	ret = no_os_irq_register_callback(dev->irq_ctrl, dev->irq_id,
					  &dev->callback_desc);
	if (ret)
		goto error_ctrl;

	ret = no_os_irq_trigger_level_set(dev->irq_ctrl, dev->irq_id,
					  NO_OS_IRQ_LEVEL_HIGH);
	if (ret)
		goto error_ctrl;

	ret = no_os_irq_enable(dev->irq_ctrl, dev->irq_id);
	if (ret)
		goto error_ctrl;

	ret = no_os_irq_global_enable(dev->irq_ctrl);
	if (ret)
		goto error_ctrl;

	*device = dev;

	return 0;

error_ctrl:
	no_os_irq_ctrl_remove(dev->irq_ctrl);
error:
	no_os_free(dev);

	return ret;
}

/**
 * @brief Disable the interrupt and free the axi_radio_hw_irq instance.
 * @param device - axi_radio_hw_irq instance.
 * @return 0 on success, negative error code otherwise.
 */
int32_t axi_radio_hw_irq_remove(struct axi_radio_hw_irq *device)
{
	if (!device)
		return -EINVAL;

	no_os_irq_disable(device->irq_ctrl, device->irq_id);
	no_os_irq_unregister_callback(device->irq_ctrl, device->irq_id,
				      &device->callback_desc);
	no_os_irq_ctrl_remove(device->irq_ctrl);

	no_os_free(device);

	return 0;
}

/******************************************************************************/
/* Enable / Disable                                                           */
/******************************************************************************/

/**
 * @brief Enable the mailbox interrupt.
 * @param device - axi_radio_hw_irq instance.
 * @return 0 on success, negative error code otherwise.
 */
int32_t axi_radio_hw_irq_enable(struct axi_radio_hw_irq *device)
{
	if (!device)
		return -EINVAL;

	return no_os_irq_enable(device->irq_ctrl, device->irq_id);
}

/**
 * @brief Disable the mailbox interrupt.
 * @param device - axi_radio_hw_irq instance.
 * @return 0 on success, negative error code otherwise.
 */
int32_t axi_radio_hw_irq_disable(struct axi_radio_hw_irq *device)
{
	if (!device)
		return -EINVAL;

	return no_os_irq_disable(device->irq_ctrl, device->irq_id);
}
